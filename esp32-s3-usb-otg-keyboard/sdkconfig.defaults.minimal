## sdkconfig.defaults
```kconfig
# Necessary for the LED screen demos
CONFIG_ESP_MAIN_TASK_STACK_SIZE=10000

# SPI RAM config
#CONFIG_SPIRAM_TYPE_AUTO=y
#CONFIG_SPIRAM_SIZE=-1

# Disable watchdogs
CONFIG_INT_WDT=n
CONFIG_ESP_TASK_WDT=n

# Workaround for https://github.com/espressif/esp-idf/issues/7631
CONFIG_MBEDTLS_CERTIFICATE_BUNDLE=n
CONFIG_MBEDTLS_CERTIFICATE_BUNDLE_DEFAULT_FULL=n

# Future: proper back-trace for esp32c3
#CONFIG_ESP_SYSTEM_USE_EH_FRAME=y
```

## sdkconfig.defaults.esp32s2
```kconfig
CONFIG_ESP32S2_ULP_COPROC_ENABLED=y
CONFIG_ESP32S2_ULP_COPROC_RESERVE_MEM=4096
CONFIG_ESP32S2_ULP_COPROC_RISCV=y
CONFIG_ESP32S2_SPIRAM_SUPPORT=y

#
# ESP32S2-specific
#
# CONFIG_ESP32S2_DEFAULT_CPU_FREQ_80 is not set
# CONFIG_ESP32S2_DEFAULT_CPU_FREQ_160 is not set
CONFIG_ESP32S2_DEFAULT_CPU_FREQ_240=y
CONFIG_ESP32S2_DEFAULT_CPU_FREQ_MHZ=240

#
# Cache config
#
CONFIG_ESP32S2_INSTRUCTION_CACHE_8KB=y
# CONFIG_ESP32S2_INSTRUCTION_CACHE_16KB is not set
# CONFIG_ESP32S2_INSTRUCTION_CACHE_LINE_16B is not set
CONFIG_ESP32S2_INSTRUCTION_CACHE_LINE_32B=y
CONFIG_ESP32S2_DATA_CACHE_8KB=y
# CONFIG_ESP32S2_DATA_CACHE_16KB is not set
# CONFIG_ESP32S2_DATA_CACHE_LINE_16B is not set
CONFIG_ESP32S2_DATA_CACHE_LINE_32B=y
# CONFIG_ESP32S2_INSTRUCTION_CACHE_WRAP is not set
# CONFIG_ESP32S2_DATA_CACHE_WRAP is not set
# end of Cache config

#
# SPI RAM config
#
CONFIG_SPIRAM_TYPE_AUTO=y
# CONFIG_SPIRAM_TYPE_ESPPSRAM16 is not set
# CONFIG_SPIRAM_TYPE_ESPPSRAM32 is not set
# CONFIG_SPIRAM_TYPE_ESPPSRAM64 is not set
CONFIG_SPIRAM_SIZE=-1
CONFIG_INT_WDT=n
CONFIG_ESP_TASK_WDT=n
```
